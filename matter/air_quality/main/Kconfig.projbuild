## matter/air_quality/main/Kconfig.projbuild
```kconfig
menu "Air Quality Sensor Unit Configuration"

    config I2C_SCAN_ENABLE
        bool "Enable I2C bus scanning on startup"
        default n
        help
            Enable scanning of I2C bus to detect connected devices.
            This is useful for debugging but may slow down startup.

    config I2C_DEVICE_PROBE_ENABLE
        bool "Enable I2C device probe before sensor initialization"
        default n
        help
            Enable probing of specific I2C devices before sensor initialization.
            This helps with debugging sensor detection issues but adds overhead.

    config EPD_UPDATE_INTERVAL_SEC
        int "EPD display update interval in seconds"
        range 10 300
        default 30
        help
            Interval for updating the EPD display with sensor data.
            Longer intervals help extend EPD lifetime.
            Range: 10-300 seconds, Default: 30 seconds.

    config SCD4X_TEMP_OFFSET_MILLICELSIUS
        int "SCD4x temperature offset in millicelsius"
        range -10000 10000
        default -5000
        help
            Temperature offset to compensate for device self-heating effects.
            The SCD4x sensor may read higher temperatures due to heat from
            the device electronics. This offset is subtracted from the raw
            temperature reading. Positive values reduce the reported temperature.
            Range: -10.0 to +10.0 degrees Celsius (in millicelsius)
            Default: -5000 millicelsius (-5.0°C offset)

endmenu
```
