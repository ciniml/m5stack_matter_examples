## openthread/ot_br/sdkconfig.defaults.coex
```kconfig
# Enable Wi-Fi coexistence and use native Thread radio.
CONFIG_SW_COEXIST_ENABLE=y
CONFIG_OPENTHREAD_RADIO_NATIVE=y
```

## openthread/ot_br/sdkconfig.defaults.esp32c6
```kconfig
# 
CONFIG_ESPTOOLPY_FLASHSIZE_4MB=y

CONFIG_OPENTHREAD_STATE_INDICATOR_ENABLE=y
CONFIG_OPENTHREAD_STATE_INDICATOR_GPIO=20

# Console config
CONFIG_ESP_CONSOLE_USB_SERIAL_JTAG=y
CONFIG_ESP_CONSOLE_SECONDARY_NONE=y

# Example
CONFIG_EXAMPLE_CONNECT_WIFI=y
CONFIG_EXAMPLE_WIFI_SSID_PWD_FROM_STDIN=y

# OpenThread
CONFIG_OPENTHREAD_BR_AUTO_START=n
CONFIG_OPENTHREAD_CONSOLE_TYPE_USB_SERIAL_JTAG=y
CONFIG_OPENTHREAD_CLI_ESP_EXTENSION=y
CONFIG_OPENTHREAD_CLI_WIFI=y
```
